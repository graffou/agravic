-- vhdl file of block mem generated by Agravic
library ieee;use ieee.std_logic_1164.all;use IEEE.NUMERIC_STD.ALL;
library work; use work.structures.all;
library work; use work.slv_utils.all;



entity mem is generic (generic_int: integer); port ( clk_mem : IN std_logic; reset_n : IN std_logic; core2mem_i : IN blk2mem_t; mem2core_o : OUT mem2blk_t ); end mem; architecture rtl of mem is component dummy_zkw_pouet is port(clk : in std_logic);end component;
component spram is generic (generic_int: integer); port ( clk_mem : IN std_logic; reset_n : IN std_logic; addr_i : IN unsigned ((24 -2 -1) downto 0); data_i : IN unsigned ((32 -1) downto 0); be_i : IN unsigned ((4 -1) downto 0); wrn_i : IN std_logic; data_o : OUT unsigned ((32 -1) downto 0) ); end component;
signal addr : unsigned ((core2mem_i.addr'length-1) downto 0);
constant max_addr : unsigned ((core2mem_i.addr'length-1) downto 0) := TO_UNSIGNED(generic_int,addr'length);
signal data_rd : unsigned ((32 -1) downto 0);
signal data_wr : unsigned ((32 -1) downto 0);
signal be : unsigned ((4 -1) downto 0);
signal wen : std_logic;
signal rd_en : unsigned ((1 -1) downto 0);


begin

 ram0 : spram generic map(generic_int => generic_int) port map( clk_mem => clk_mem, reset_n => reset_n, addr_i => addr, data_i => data_wr, data_o => data_rd, be_i => be, wrn_i => wen) ;
 process0 : process(clk_mem,reset_n)

 begin
  IF ( reset_n = '0' ) then
   rd_en <= "0";
  elsif ( clk_mem'event and (clk_mem = '1' ) ) then
   IF ( (core2mem_i.cs_n = '0') and ((core2mem_i.addr) < max_addr) ) then
    IF ((core2mem_i.wr_n = '1' )) then
     rd_en <= "1";

    else
     rd_en <= "0";
    end if;
   else
    rd_en <= "0";
   end if;

  end if;
 end process;


  addr <= ( ( core2mem_i.addr ) and unsigned(RESIZE(signed(BOOL2BIN( core2mem_i.addr < max_addr )), addr'length)) );
  data_wr <= core2mem_i.data;
  wen <= ( not core2mem_i.cs_n and not core2mem_i.wr_n and BOOL2BIT(core2mem_i.addr < max_addr ) );
  be <= core2mem_i.be;
  mem2core_o.data <= ( data_rd and unsigned(RESIZE(signed(rd_en), 32)));
  mem2core_o.data_en <= rd_en(0);
end rtl;
